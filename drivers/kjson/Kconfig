## drivers/kjson/Kconfig
```kconfig
# SPDX-License-Identifier: GPL-2.0-only
# Copyright (C) 2023. Emanuele Santini (emanuele.santini.88@gmail.com).

config KJSON
	tristate "config json for kernel"
	default y
	help
	  define this config to support json files
```

## drivers/oplus/Kconfig
```kconfig
# SPDX-License-Identifier: GPL-2.0-only
# Copyright (C) 2018-2020 Oplus. All rights reserved.

config OPLUS
	tristate "config oplus drivers info for kernel"
	default y
	help
	  define this config to support oplus drivers

config OPLUS_SUBSYS_SLEEP_MONITOR
	tristate "monitor Qualcomm subsystem sleep"
	depends on OPLUS
	default y
	help
	  This selects to get sleep info for Qualcomm subsystem

config OPLUS_WAKELOCK_PROFILER 
	tristate "config oplus wakelock profiler"
	depends on OPLUS
	default y
	help
	  Select this config to enable oplus wakelock profiler

source "drivers/oplus/oplus_nandswap/Kconfig"
source "drivers/oplus/uxio_first/Kconfig"
```

## drivers/oplus/oplus_nandswap/Kconfig
```kconfig
config NANDSWAP
	bool "nandswap feature"
	depends on OPLUS
	default n
	help
	 nandswap feature

config NANDSWAP_DEBUG
	bool "nandswap debug"
	depends on F2FS_FS
	default n
	help
	 nandswap debug
```

## drivers/power/supply/ti/Kconfig
```kconfig
menu "TI Technologies, Inc. Charger support"

config BQ2597X_CHARGE_PUMP
	tristate "BQ2597X power supply framework based driver"
	depends on I2C
	help
	  Say Y to include support for BQ2597X Charge Pump driver based on
	  power supply framework.
	  BQ2597X is a div2 charge pump capable of delivering 8A charge current
	  with very high efficiency.

config BQ2597X_CHARGE_PUMP_PIPA
	tristate "BQ2597X power supply framework based driver"
	depends on I2C
	help
	  Say Y to include support for BQ2597X Charge Pump driver based on
	  power supply framework.
	  BQ2597X is a div2 charge pump capable of delivering 8A charge current
	  with very high efficiency.

config BQ2597X_CHARGE_PUMP_DAGU
	tristate "BQ2597X power supply framework based driver"
	depends on I2C
	help
	  Say Y to include support for BQ2597X Charge Pump driver based on
	  power supply framework.
	  BQ2597X is a div2 charge pump capable of delivering 8A charge current
	  with very high efficiency.

config BQ2597X_CHARGE_PUMP_STANDALONE
	tristate "BQ2597X power supply framework based driver"
	depends on I2C
	help
	  Say Y to include support for BQ2597X Charge Pump driver based on
	  power supply framework.
	  BQ2597X is a div2 charge pump capable of delivering 8A charge current
	  with very high efficiency.

config BQ2597X_CHARGE_PUMP_STANDALONE_MUNCH
	tristate "BQ2597X power supply framework based driver"
	depends on I2C
	help
	  Say Y to include support for BQ2597X Charge Pump driver based on
	  power supply framework.
	  BQ2597X is a div2 charge pump capable of delivering 8A charge current
	  with very high efficiency.

config LN8282
	tristate "LN8282 Charge Pump"
	depends on I2C
	help
	  Say Y to include support for LN8282 charger pump.
	  Lion Semiconductor Inc. LN8282 is a charger pump chip.
	  The driver supports charger enable/disable.
	  The driver reports the charger status via the power supply framework.
	  The driver controls 8282 via I2C and
	  supports device-tree interface.

config CHARGER_LN8000
	tristate "LionSemi LN8000 Battery Charger"
	depends on I2C
	select REGMAP_I2C
	help
	  Say Y to enable support for the LN8000 charger

config BQ_PUMP_WIRELESS_CHARGE
	tristate "BQ2597X wireless dc charge policy driver"
	depends on I2C
	help
	  Say Y to include support for BQ2597X Charge Pump Wireless Charging
	  based on power supply framework.

config DUAL_BQ2597X
	tristate "BQ2597X power supply framework based driver"
	depends on I2C
	help
	 Say Y to include support for dual BQ2597X Charge Pump driver based on
	 power supply framework.

config CHARGER_LN8000_PSYCHE
	tristate "LionSemi LN8000 Battery Charger"
	depends on I2C
	select REGMAP_I2C
	help
	 Say Y to enable support for the LN8000 charger
endmenu
```

## techpack/Kconfig
```kconfig
menu "Tech packages"

source "techpack/data/Kconfig"

menu "Xiaomi Camera Configuration"

config CAMERA_XIAOMI
	bool "Enable Xiaomi Old Camera modifications"
	help
	  "Enable Xiaomi Old Camera modifications"

config CAMERA_NONEDXO
	bool "Enable None-DXO Camera modifications"
	help
	  "Enable None-DXO Camera modifications"

config CAMERA_CAS
	bool "Enable Xiaomi CAS Camera modifications"
	help
	  "Enable Xiaomi CAS Camera modifications"

endmenu

endmenu
```
